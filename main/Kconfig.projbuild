## main/Kconfig.projbuild
```kconfig
menu "Benchmarks"

config BENCH_MENU
    bool "Enable UART scenario menu"
    default y
    help
      When enabled, the app shows a UART menu at startup to select a scenario.
      Disable for final research runs to keep code layout minimal and avoid
      any potential impact on timing (the menu is removed at compile time).

endmenu
```

## sdkconfig.defaults
```kconfig
CONFIG_ESP_DEFAULT_CPU_FREQ_MHZ_240=y
CONFIG_ESP_DEFAULT_CPU_FREQ_MHZ=240
CONFIG_FREERTOS_IDLE_TASK_STACKSIZE=3072
# Watchdog configuration for long-running benchmarks
# Don't check idle tasks - they get starved during long crypto operations
CONFIG_ESP_TASK_WDT_CHECK_IDLE_TASK_CPU0=n
CONFIG_ESP_TASK_WDT_CHECK_IDLE_TASK_CPU1=n
# Set reasonable timeout for actual task monitoring
CONFIG_ESP_TASK_WDT_TIMEOUT_S=30
```
